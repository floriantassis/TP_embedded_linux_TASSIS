## TP2/build-ynov-rpi/conf/bblayers.conf
```bitbake
# POKY_BBLAYERS_CONF_VERSION is increased each time build/conf/bblayers.conf
# changes incompatibly
POKY_BBLAYERS_CONF_VERSION = "2"

BBPATH = "${TOPDIR}"
BBFILES ?= ""

BBLAYERS ?= " \
  /home/florian/yocto/poky/meta \
  /home/florian/yocto/poky/meta-poky \
  /home/florian/yocto/poky/meta-yocto-bsp \
  /home/florian/yocto/meta-raspberrypi \
  /home/florian/yocto/meta-openembedded/meta-oe \
  /home/florian/yocto/meta-openembedded/meta-networking \
  /home/florian/yocto/meta-openembedded/meta-python \
  /home/florian/yocto/meta-openembedded/meta-filesystems \
  /home/florian/yocto/meta-openembedded/meta-multimedia \
  /home/florian/bachelor-embedded-linux/labs/lab2/meta-ynov-rpi4 \
  /home/florian/yocto/meta-virtualization \
  "
```
